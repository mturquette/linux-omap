## drivers/clk/Kconfig
```kconfig
config CLKDEV_LOOKUP
	bool
	select HAVE_CLK

config HAVE_MACH_CLKDEV
	bool

config GENERIC_CLK
	bool

config GENERIC_CLK_BUILD_TEST
	bool "Build all generic clock drivers"
	depends on EXPERIMENTAL && GENERIC_CLK
	select GENERIC_CLK_FIXED
	select GENERIC_CLK_GATE
	help
	   Enable all possible generic clock drivers.  This is only
	   useful for improving build coverage, it is not useful for
	   production kernel builds.

config GENERIC_CLK_FIXED
	bool
	depends on GENERIC_CLK

config GENERIC_CLK_GATE
	bool
	depends on GENERIC_CLK
```

## drivers/cpuoffline/Kconfig
```kconfig
config CPU_OFFLINE
	bool "CPUoffline framework"
	help
	  CPUoffline provides a framework that allows for taking CPUs
	  offline via an in-kernel governor.  The governor itself can
	  implement any number of policies for deciding to offline a
	  core.  Though primarily used for power capping, CPUoffline can
	  also be used to implement a thermal duty to prevent core
	  over-heating, etc.

	  For details please see <file:Documentation/cpuoffline>.

	  If in doubt, say N.

config CPU_OFFLINE_DEFAULT_DRIVER
	bool "CPUoffline default driver"
	depends on CPU_OFFLINE
	help
	  A default driver that creates a single partition containing
	  all possible CPUs.  The benefit of this driver is that a
	  platform does not need any new code to make use of the
	  CPUoffline framework.  Do not select this if your platform
	  implements it's own driver for registering partitions and CPUs
	  with the CPUoffline framework.

	  If in doubt, say N.
```

## drivers/cpuoffline/governors/Kconfig
```kconfig
config CPU_OFFLINE_GOVERNOR_AVGLOAD
	bool "CPUoffline Avgload governor"
	depends on CPU_OFFLINE
	help
	  A simple governor that puts CPUs online or offline based on
	  CPU load statistics.  It will always leave one CPU online in a
	  partition.

	  If in doubt, say N.
```
